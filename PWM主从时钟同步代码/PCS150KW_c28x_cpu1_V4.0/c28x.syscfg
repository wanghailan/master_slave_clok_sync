/**
 * @cliArgs --device "F2838x" --part "F2838x_337bga" --package "337bga" --context "CPU1" --product "C2000WARE@5.01.00.00"
 * @versions {"tool":"1.21.0+3721"}
 */

/**
 * Import the modules used in this configuration.
 */
const clb   = scripting.addModule("/driverlib/clb.js", {}, false);
const clb1  = clb.addInstance();
const clb2  = clb.addInstance();
const clb3  = clb.addInstance();
const clb4  = clb.addInstance();
const TILE  = scripting.addModule("/utilities/clb_tool/clb_syscfg/source/TILE", {}, false);
const TILE1 = TILE.addInstance();
const TILE2 = TILE.addInstance();
const TILE3 = TILE.addInstance();
const TILE4 = TILE.addInstance();

/**
 * Write custom configuration values to the imported modules.
 */
clb1.$name                           = "myCLB5";
clb1.clbBase                         = "CLB5_BASE";
clb1.outputsToOverridePeripheral     = ["CLB_OUT0","CLB_OUT2"];
clb1.inputTypeCLB_IN0                = "GLOBAL";
clb1.globalConfigCLB_IN0             = "CLB_GLOBAL_IN_MUX_EPWM5A";
clb1.synchronizeCLB_IN0              = true;
clb1.lockOutputsToOverridePeripheral = true;
clb1.inputTypeCLB_IN1                = "GLOBAL";
clb1.synchronizeCLB_IN1              = true;
clb1.globalConfigCLB_IN1             = "CLB_GLOBAL_IN_MUX_EPWM5B";
clb1.inputsUsed                      = ["CLB_IN0","CLB_IN1","CLB_IN2","CLB_IN3"];
clb1.inputTypeCLB_IN3                = "GLOBAL";
clb1.synchronizeCLB_IN3              = true;
clb1.globalConfigCLB_IN3             = "CLB_GLOBAL_IN_MUX_EPWM6B";

clb2.$name                           = "myCLB6";
clb2.clbBase                         = "CLB6_BASE";
clb2.outputsToOverridePeripheral     = ["CLB_OUT0","CLB_OUT2"];
clb2.inputTypeCLB_IN0                = "GLOBAL";
clb2.synchronizeCLB_IN0              = true;
clb2.inputTypeCLB_IN1                = "GLOBAL";
clb2.synchronizeCLB_IN1              = true;
clb2.lockOutputsToOverridePeripheral = true;
clb2.globalConfigCLB_IN0             = "CLB_GLOBAL_IN_MUX_EPWM6A";
clb2.globalConfigCLB_IN1             = "CLB_GLOBAL_IN_MUX_EPWM6B";
clb2.inputsUsed                      = ["CLB_IN0","CLB_IN1","CLB_IN2","CLB_IN3"];
clb2.inputTypeCLB_IN3                = "GLOBAL";
clb2.synchronizeCLB_IN3              = true;
clb2.globalConfigCLB_IN3             = "CLB_GLOBAL_IN_MUX_EPWM5A";

clb3.$name                           = "myCLB7";
clb3.clbBase                         = "CLB7_BASE";
clb3.outputsToOverridePeripheral     = ["CLB_OUT0","CLB_OUT2"];
clb3.lockOutputsToOverridePeripheral = true;
clb3.inputsUsed                      = ["CLB_IN0","CLB_IN1","CLB_IN2","CLB_IN3"];
clb3.inputTypeCLB_IN0                = "GLOBAL";
clb3.globalConfigCLB_IN0             = "CLB_GLOBAL_IN_MUX_EPWM7A";
clb3.synchronizeCLB_IN0              = true;
clb3.inputTypeCLB_IN1                = "GLOBAL";
clb3.globalConfigCLB_IN1             = "CLB_GLOBAL_IN_MUX_EPWM7B";
clb3.synchronizeCLB_IN1              = true;
clb3.inputTypeCLB_IN3                = "GLOBAL";
clb3.globalConfigCLB_IN3             = "CLB_GLOBAL_IN_MUX_EPWM8B";
clb3.synchronizeCLB_IN3              = true;

clb4.$name                           = "myCLB8";
clb4.clbBase                         = "CLB8_BASE";
clb4.outputsToOverridePeripheral     = ["CLB_OUT0","CLB_OUT2"];
clb4.lockOutputsToOverridePeripheral = true;
clb4.inputsUsed                      = ["CLB_IN0","CLB_IN1","CLB_IN2","CLB_IN3"];
clb4.inputTypeCLB_IN0                = "GLOBAL";
clb4.globalConfigCLB_IN0             = "CLB_GLOBAL_IN_MUX_EPWM8A";
clb4.synchronizeCLB_IN0              = true;
clb4.inputTypeCLB_IN1                = "GLOBAL";
clb4.globalConfigCLB_IN1             = "CLB_GLOBAL_IN_MUX_EPWM8B";
clb4.synchronizeCLB_IN1              = true;
clb4.inputTypeCLB_IN3                = "GLOBAL";
clb4.globalConfigCLB_IN3             = "CLB_GLOBAL_IN_MUX_EPWM7A";
clb4.synchronizeCLB_IN3              = true;

TILE1.$name              = "CLBTILE5";
TILE1.BOUNDARY.$name     = "BOUNDARY4";
TILE1.LUT_0.$name        = "LUT_12";
TILE1.LUT_0.i0           = "BOUNDARY.in0";
TILE1.LUT_0.i1           = "BOUNDARY.in3";
TILE1.LUT_0.eqn          = "~(i0&i1)";
TILE1.LUT_1.$name        = "LUT_13";
TILE1.LUT_2.$name        = "LUT_14";
TILE1.FSM_0.$name        = "FSM_12";
TILE1.FSM_1.$name        = "FSM_13";
TILE1.FSM_2.$name        = "FSM_14";
TILE1.COUNTER_0.$name    = "COUNTER_12";
TILE1.COUNTER_1.$name    = "COUNTER_13";
TILE1.COUNTER_2.$name    = "COUNTER_14";
TILE1.OUTLUT_0.$name     = "OUTLUT_32";
TILE1.OUTLUT_0.i0        = "BOUNDARY.in0";
TILE1.OUTLUT_0.i1        = "BOUNDARY.in2";
TILE1.OUTLUT_0.i2        = "LUT_0.OUT";
TILE1.OUTLUT_0.eqn       = "i0&i1";
TILE1.OUTLUT_1.$name     = "OUTLUT_33";
TILE1.OUTLUT_2.$name     = "OUTLUT_34";
TILE1.OUTLUT_2.i0        = "BOUNDARY.in1";
TILE1.OUTLUT_2.i1        = "BOUNDARY.in2";
TILE1.OUTLUT_2.i2        = "LUT_0.OUT";
TILE1.OUTLUT_2.eqn       = "i0&i1";
TILE1.OUTLUT_3.$name     = "OUTLUT_35";
TILE1.OUTLUT_4.$name     = "OUTLUT_36";
TILE1.OUTLUT_5.$name     = "OUTLUT_37";
TILE1.OUTLUT_6.$name     = "OUTLUT_38";
TILE1.OUTLUT_7.$name     = "OUTLUT_39";
TILE1.HLC.$name          = "HLC_4";
TILE1.HLC.program0.$name = "HLCP_16";
TILE1.HLC.program1.$name = "HLCP_17";
TILE1.HLC.program2.$name = "HLCP_18";
TILE1.HLC.program3.$name = "HLCP_19";
TILE1.AOC_0.$name        = "AOC_32";
TILE1.AOC_1.$name        = "AOC_33";
TILE1.AOC_2.$name        = "AOC_34";
TILE1.AOC_3.$name        = "AOC_35";
TILE1.AOC_4.$name        = "AOC_36";
TILE1.AOC_5.$name        = "AOC_37";
TILE1.AOC_6.$name        = "AOC_38";
TILE1.AOC_7.$name        = "AOC_39";

TILE2.$name              = "CLBTILE6";
TILE2.BOUNDARY.$name     = "BOUNDARY5";
TILE2.LUT_0.$name        = "LUT_15";
TILE2.LUT_0.i1           = "BOUNDARY.in3";
TILE2.LUT_0.i0           = "BOUNDARY.in1";
TILE2.LUT_0.eqn          = "~(i0&i1)";
TILE2.LUT_1.$name        = "LUT_16";
TILE2.LUT_2.$name        = "LUT_17";
TILE2.FSM_0.$name        = "FSM_15";
TILE2.FSM_1.$name        = "FSM_16";
TILE2.FSM_2.$name        = "FSM_17";
TILE2.COUNTER_0.$name    = "COUNTER_15";
TILE2.COUNTER_1.$name    = "COUNTER_16";
TILE2.COUNTER_2.$name    = "COUNTER_17";
TILE2.OUTLUT_0.$name     = "OUTLUT_40";
TILE2.OUTLUT_0.i0        = "BOUNDARY.in0";
TILE2.OUTLUT_0.i2        = "LUT_0.OUT";
TILE2.OUTLUT_0.i1        = "BOUNDARY.in2";
TILE2.OUTLUT_0.eqn       = "i0&i1";
TILE2.OUTLUT_1.$name     = "OUTLUT_41";
TILE2.OUTLUT_2.$name     = "OUTLUT_42";
TILE2.OUTLUT_2.i0        = "BOUNDARY.in1";
TILE2.OUTLUT_2.i1        = "BOUNDARY.in2";
TILE2.OUTLUT_2.i2        = "LUT_0.OUT";
TILE2.OUTLUT_2.eqn       = "i0&i1";
TILE2.OUTLUT_3.$name     = "OUTLUT_43";
TILE2.OUTLUT_4.$name     = "OUTLUT_44";
TILE2.OUTLUT_5.$name     = "OUTLUT_45";
TILE2.OUTLUT_6.$name     = "OUTLUT_46";
TILE2.OUTLUT_7.$name     = "OUTLUT_47";
TILE2.HLC.$name          = "HLC_5";
TILE2.HLC.program0.$name = "HLCP_20";
TILE2.HLC.program1.$name = "HLCP_21";
TILE2.HLC.program2.$name = "HLCP_22";
TILE2.HLC.program3.$name = "HLCP_23";
TILE2.AOC_0.$name        = "AOC_40";
TILE2.AOC_1.$name        = "AOC_41";
TILE2.AOC_2.$name        = "AOC_42";
TILE2.AOC_3.$name        = "AOC_43";
TILE2.AOC_4.$name        = "AOC_44";
TILE2.AOC_5.$name        = "AOC_45";
TILE2.AOC_6.$name        = "AOC_46";
TILE2.AOC_7.$name        = "AOC_47";

TILE3.$name              = "CLBTILE8";
TILE3.BOUNDARY.$name     = "BOUNDARY0";
TILE3.LUT_0.$name        = "LUT_0";
TILE3.LUT_0.i0           = "BOUNDARY.in1";
TILE3.LUT_0.i1           = "BOUNDARY.in3";
TILE3.LUT_0.eqn          = "~(i0&i1)";
TILE3.LUT_1.$name        = "LUT_1";
TILE3.LUT_2.$name        = "LUT_2";
TILE3.FSM_0.$name        = "FSM_0";
TILE3.FSM_1.$name        = "FSM_1";
TILE3.FSM_2.$name        = "FSM_2";
TILE3.COUNTER_0.$name    = "COUNTER_0";
TILE3.COUNTER_1.$name    = "COUNTER_1";
TILE3.COUNTER_2.$name    = "COUNTER_2";
TILE3.OUTLUT_0.$name     = "OUTLUT_0";
TILE3.OUTLUT_0.i0        = "BOUNDARY.in0";
TILE3.OUTLUT_0.i1        = "BOUNDARY.in2";
TILE3.OUTLUT_0.i2        = "LUT_0.OUT";
TILE3.OUTLUT_0.eqn       = "i0&i1";
TILE3.OUTLUT_1.$name     = "OUTLUT_1";
TILE3.OUTLUT_2.$name     = "OUTLUT_2";
TILE3.OUTLUT_2.i0        = "BOUNDARY.in1";
TILE3.OUTLUT_2.i1        = "BOUNDARY.in2";
TILE3.OUTLUT_2.i2        = "LUT_0.OUT";
TILE3.OUTLUT_2.eqn       = "i0&i1";
TILE3.OUTLUT_3.$name     = "OUTLUT_3";
TILE3.OUTLUT_4.$name     = "OUTLUT_4";
TILE3.OUTLUT_5.$name     = "OUTLUT_5";
TILE3.OUTLUT_6.$name     = "OUTLUT_6";
TILE3.OUTLUT_7.$name     = "OUTLUT_7";
TILE3.HLC.$name          = "HLC_0";
TILE3.HLC.program0.$name = "HLCP_0";
TILE3.HLC.program1.$name = "HLCP_1";
TILE3.HLC.program2.$name = "HLCP_2";
TILE3.HLC.program3.$name = "HLCP_3";
TILE3.AOC_0.$name        = "AOC_0";
TILE3.AOC_1.$name        = "AOC_1";
TILE3.AOC_2.$name        = "AOC_2";
TILE3.AOC_3.$name        = "AOC_3";
TILE3.AOC_4.$name        = "AOC_4";
TILE3.AOC_5.$name        = "AOC_5";
TILE3.AOC_6.$name        = "AOC_6";
TILE3.AOC_7.$name        = "AOC_7";

TILE4.$name              = "CLBTILE7";
TILE4.BOUNDARY.$name     = "BOUNDARY1";
TILE4.LUT_0.$name        = "LUT_3";
TILE4.LUT_0.i0           = "BOUNDARY.in0";
TILE4.LUT_0.i1           = "BOUNDARY.in3";
TILE4.LUT_0.eqn          = "~(i0&i1)";
TILE4.LUT_1.$name        = "LUT_4";
TILE4.LUT_2.$name        = "LUT_5";
TILE4.FSM_0.$name        = "FSM_3";
TILE4.FSM_1.$name        = "FSM_4";
TILE4.FSM_2.$name        = "FSM_5";
TILE4.COUNTER_0.$name    = "COUNTER_3";
TILE4.COUNTER_1.$name    = "COUNTER_4";
TILE4.COUNTER_2.$name    = "COUNTER_5";
TILE4.OUTLUT_0.$name     = "OUTLUT_8";
TILE4.OUTLUT_0.i0        = "BOUNDARY.in0";
TILE4.OUTLUT_0.i1        = "BOUNDARY.in2";
TILE4.OUTLUT_0.i2        = "LUT_0.OUT";
TILE4.OUTLUT_0.eqn       = "i0&i1";
TILE4.OUTLUT_1.$name     = "OUTLUT_9";
TILE4.OUTLUT_2.$name     = "OUTLUT_10";
TILE4.OUTLUT_2.i0        = "BOUNDARY.in1";
TILE4.OUTLUT_2.i1        = "BOUNDARY.in2";
TILE4.OUTLUT_2.i2        = "LUT_0.OUT";
TILE4.OUTLUT_2.eqn       = "i0&i1";
TILE4.OUTLUT_3.$name     = "OUTLUT_11";
TILE4.OUTLUT_4.$name     = "OUTLUT_12";
TILE4.OUTLUT_5.$name     = "OUTLUT_13";
TILE4.OUTLUT_6.$name     = "OUTLUT_14";
TILE4.OUTLUT_7.$name     = "OUTLUT_15";
TILE4.HLC.$name          = "HLC_1";
TILE4.HLC.program0.$name = "HLCP_4";
TILE4.HLC.program1.$name = "HLCP_5";
TILE4.HLC.program2.$name = "HLCP_6";
TILE4.HLC.program3.$name = "HLCP_7";
TILE4.AOC_0.$name        = "AOC_8";
TILE4.AOC_1.$name        = "AOC_9";
TILE4.AOC_2.$name        = "AOC_10";
TILE4.AOC_3.$name        = "AOC_11";
TILE4.AOC_4.$name        = "AOC_12";
TILE4.AOC_5.$name        = "AOC_13";
TILE4.AOC_6.$name        = "AOC_14";
TILE4.AOC_7.$name        = "AOC_15";
